## CMakeLists.txt
```
cmake_minimum_required(VERSION 3.20.0)
get_filename_component(SAY_HELLO_PATH
    "${CMAKE_SOURCE_DIR}/modules/say_hello"
    REALPATH
)

message(STATUS "Resolved path = ${SAY_HELLO_PATH}")
set(ZEPHYR_EXTRA_MODULES "${SAY_HELLO_PATH}")
find_package(
    Zephyr REQUIRED HINTS $ENV{ZEPHYR_BASE}
)
project(module_demo)
target_sources(app PRIVATE src/main.c)
```

## prj.conf
```kconfig
CONFIG_STACK_POINTER_RANDOM=0
CONFIG_TEST_RANDOM_GENERATOR=y
CONFIG_TIMER_RANDOM_GENERATOR=y
CONFIG_TEST_CSPRNG_GENERATOR=y

CONFIG_CONSOLE=y
CONFIG_PRINTK=y
CONFIG_SERIAL=y
CONFIG_UART_CONSOLE=y


CONFIG_TIMER_RANDOM_GENERATOR=y
CONFIG_SAY_HELLO=y
CONFIG_CBPRINTF_FP_SUPPORT=y
```

## src/main.c
```c
#include <stdio.h>
#include <zephyr/random/random.h>
#ifdef CONFIG_SAY_HELLO
#include "say_hello.h"
#endif
static const uint32_t sleep_time_ms = 1000;
int main(void)
{
    uint32_t rand_num;
    while(1)
    {
        double float_num;
        rand_num = sys_rand32_get();
        printk("Random Number: %u\n", rand_num);
        float_num = (double)rand_num / (UINT32_MAX + 1.0);
        printk("Float number: %f\n", float_num);
        #ifdef CONFIG_SAY_HELLO
        say_hello();
        #endif
        k_msleep(sleep_time_ms);
    }
}
```
